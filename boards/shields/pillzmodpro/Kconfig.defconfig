## boards/shields/pillzmodpro/Kconfig.defconfig
```kconfig
if SHIELD_PILLZMODPRO

config ZMK_KEYBOARD_NAME
    default "PillzMod Pro"

config SPI
    default y
    
endif
```

## config/boards/shields/pillzmod_pro/Kconfig.defconfig
```kconfig
if SHIELD_PILLZMOD_PRO

config ZMK_KEYBOARD_NAME
    default "pillzmod_pro"

config SPI
    default y
    
endif
```
